## CMakeLists.txt
```
# SPDX-License-Identifier: Apache-2.0

cmake_minimum_required(VERSION 3.20.0)

find_package(Zephyr COMPONENTS unittest REQUIRED HINTS $ENV{ZEPHYR_BASE})

project(bt_keys_br_eviction)

add_subdirectory(${ZEPHYR_BASE}/tests/bluetooth/host host_mocks)

target_link_libraries(testbinary PRIVATE host_mocks)

target_sources(testbinary PRIVATE
    src/main.c
    ${ZEPHYR_BASE}/subsys/bluetooth/host/classic/keys_br.c
    ${ZEPHYR_BASE}/subsys/bluetooth/common/addr.c
)
```

## prj.conf
```kconfig
CONFIG_ZTEST=y
CONFIG_BT=y
CONFIG_BT_CLASSIC=y
CONFIG_BT_MAX_PAIRED=2
CONFIG_BT_KEYS_OVERWRITE_OLDEST=y
CONFIG_BT_SETTINGS=n
CONFIG_LOG=n
CONFIG_TEST_LOGGING_DEFAULTS=n
```

## src/main.c
```c
/*
 * SPDX-License-Identifier: Apache-2.0
 */

#include <zephyr/bluetooth/addr.h>
#include <zephyr/ztest.h>

#include <host/keys.h>

ZTEST(bt_keys_br_eviction, test_recently_used_bond_survives_ram_only_eviction)
{
	static const bt_addr_t a = { .val = { 1, 0, 0, 0, 0, 0 } };
	static const bt_addr_t b = { .val = { 2, 0, 0, 0, 0, 0 } };
	static const bt_addr_t c = { .val = { 3, 0, 0, 0, 0, 0 } };

	zassert_not_null(bt_keys_get_link_key(&a));
	zassert_not_null(bt_keys_get_link_key(&b));

	bt_keys_link_key_update_usage(&a);

	zassert_not_null(bt_keys_get_link_key(&c));
	zassert_not_null(bt_keys_find_link_key(&a));
	zassert_is_null(bt_keys_find_link_key(&b));
	zassert_not_null(bt_keys_find_link_key(&c));
}

ZTEST_SUITE(bt_keys_br_eviction, NULL, NULL, NULL, NULL, NULL);
```
