## CMakeLists.txt
```
# SPDX-License-Identifier: Apache-2.0
cmake_minimum_required(VERSION 3.20.0)
find_package(Zephyr REQUIRED HINTS $ENV{ZEPHYR_BASE})
project(uart_cmsdk_apb)
target_sources(app PRIVATE src/main.c)
```

## prj.conf
```kconfig
# SPDX-License-Identifier: Apache-2.0
CONFIG_ZTEST=y
CONFIG_SERIAL=y
CONFIG_UART_INTERRUPT_DRIVEN=y
```

## app.overlay
```dts
/* SPDX-License-Identifier: Apache-2.0 */
/ {
	aliases { test-uart = &uart1; };
};
&uart1 { status = "okay"; };
```

## src/main.c
```c
/* SPDX-License-Identifier: Apache-2.0 */
#include <zephyr/drivers/uart.h>
#include <zephyr/kernel.h>
#include <zephyr/ztest.h>

static const struct device *const uart = DEVICE_DT_GET(DT_ALIAS(test_uart));
static K_SEM_DEFINE(called, 0, 1);
static int before, after;

static void tx_ready(const struct device *dev, void *context)
{
	if (!uart_irq_update(dev) || !uart_irq_tx_ready(dev)) {
		return;
	}
	before = uart_irq_tx_complete(dev);
	uart_irq_tx_disable(dev);
	after = uart_irq_tx_complete(dev);
	k_sem_give(&called);
}

ZTEST(cmsdk_apb, test_idle_completion_with_masked_tx_interrupt)
{
	zassert_true(device_is_ready(uart));
	zassert_ok(uart_irq_callback_user_data_set(uart, tx_ready, NULL));
	/* No warm-up transmission: a cold, idle transmitter is already complete. */
	for (int i = 0; i < 2; i++) {
		uart_irq_tx_enable(uart);
		zassert_ok(k_sem_take(&called, K_SECONDS(1)));
		zassert_equal(before, 1);
		zassert_equal(after, 1, "Disabling TX IRQ changed completion of an idle UART");
	}
}

ZTEST_SUITE(cmsdk_apb, NULL, NULL, NULL, NULL, NULL);
```
