## CMakeLists.txt
```
# SPDX-License-Identifier: Apache-2.0
cmake_minimum_required(VERSION 3.20.0)
find_package(Zephyr REQUIRED HINTS $ENV{ZEPHYR_BASE})
project(adc_stm32_timeout)
target_sources(app PRIVATE src/main.c)
```

## prj.conf
```kconfig
# SPDX-License-Identifier: Apache-2.0
CONFIG_ZTEST=y
CONFIG_ADC=y
CONFIG_ADC_ASYNC=y
CONFIG_ADC_STM32_CONVERSION_TIMEOUT_MS=2
CONFIG_SYS_CLOCK_TICKS_PER_SEC=10000
```

## app.overlay
```dts
/* SPDX-License-Identifier: Apache-2.0 */
#include <zephyr/dt-bindings/adc/adc.h>
/ {
	zephyr,user {
		io-channels = <&adc1 0>;
	};
};
&adc1 {
	status = "okay";
	pinctrl-0 = <&adc1_in0_pa0>;
	pinctrl-names = "default";
	st,adc-prescaler = <4>;
	#address-cells = <1>;
	#size-cells = <0>;
	channel@0 {
		reg = <0>;
		zephyr,gain = "ADC_GAIN_1";
		zephyr,reference = "ADC_REF_INTERNAL";
		zephyr,acquisition-time = <ADC_ACQ_TIME(ADC_ACQ_TIME_TICKS, 15)>;
		zephyr,resolution = <12>;
	};
};
```

## src/main.c
```c
/* SPDX-License-Identifier: Apache-2.0 */
#include <zephyr/drivers/adc.h>
#include <zephyr/kernel.h>
#include <zephyr/ztest.h>
#include <cmsis_core.h>

/* Physical F4 regression: mask only the ADC IRQ, leaving the kernel timer
 * running. Timeout must complete the read before a late IRQ can use its buffer.
 * No input voltage or external loopback is required for these lifecycle checks.
 */
static const struct adc_dt_spec adc = ADC_DT_SPEC_GET(DT_PATH(zephyr_user));
#define ADC_IRQ DT_IRQN(DT_NODELABEL(adc1))

ZTEST(adc_timeout, test_timeout_recovery_and_sequence)
{
	uint16_t samples[3] = {0};
	struct adc_sequence sequence = {.buffer = samples, .buffer_size = sizeof(samples)};

	zassert_true(adc_is_ready_dt(&adc));
	zassert_ok(adc_channel_setup_dt(&adc));
	zassert_ok(adc_sequence_init_dt(&adc, &sequence));
	/* The first operation must also work from the driver's cold state. */
	zassert_ok(adc_read_dt(&adc, &sequence));
	irq_disable(ADC_IRQ);
	int64_t start = k_uptime_get();
	int result = adc_read_dt(&adc, &sequence);

	/* Restore IRQ admission even on failure before reporting assertions. */
	irq_enable(ADC_IRQ);
	zassert_equal(result, -ETIMEDOUT);
	zassert_between_inclusive(k_uptime_get() - start, 2, 20);
	samples[0] = 0x5a5a;
	NVIC_SetPendingIRQ(ADC_IRQ);
	k_msleep(3);
	zassert_equal(samples[0], 0x5a5a, "Late ISR wrote into completed buffer");
	zassert_ok(adc_read_dt(&adc, &sequence));
	zassert_true(samples[0] < 4096);

	struct k_poll_signal signal = K_POLL_SIGNAL_INITIALIZER(signal);
	struct k_poll_event event = K_POLL_EVENT_INITIALIZER(
		K_POLL_TYPE_SIGNAL, K_POLL_MODE_NOTIFY_ONLY, &signal);

	irq_disable(ADC_IRQ);
	result = adc_read_async(adc.dev, &sequence, &signal);
	int waited = result ? result : k_poll(&event, 1, K_MSEC(20));

	irq_enable(ADC_IRQ);
	zassert_ok(result);
	zassert_ok(waited);
	unsigned int signaled;
	k_poll_signal_check(&signal, &signaled, &result);
	zassert_true(signaled);
	zassert_equal(result, -ETIMEDOUT);
	zassert_ok(adc_read_dt(&adc, &sequence));

	/* Intentional intervals exceed the per-conversion timeout. */
	struct adc_sequence_options options = {.interval_us = 5000, .extra_samplings = 2};
	sequence.options = &options;
	zassert_ok(adc_read_dt(&adc, &sequence));
	for (size_t i = 0; i < ARRAY_SIZE(samples); i++) {
		zassert_true(samples[i] < 4096);
	}
}
ZTEST_SUITE(adc_timeout, NULL, NULL, NULL, NULL, NULL);
```
