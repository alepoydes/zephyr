## dts/bindings/usb/st,stm32-otg-bc12.yaml
```yaml
# SPDX-License-Identifier: Apache-2.0
description: |
  Embedded full-speed USB PHY charger detection on STM32F412/F413/F423.
  This node is a child of the STM32 OTG device controller. The controller
  must be initialized and disabled before selecting portable-device mode.
  Enable USB only after detection completes; selecting disconnected mode
  cancels detection and restores the PHY. Charging-port mode is unsupported.

compatible: "st,stm32-otg-bc12"
include:
  - name: usb-bc12.yaml
    property-blocklist: [charging-mode]

properties:
  charging-mode:
    type: string
    default: "BC12_TYPE_NONE"
    enum:
      - BC12_TYPE_NONE
```

## tests/arch/arm/mpu_irq/testcase.yaml
```yaml
tests:
  arch.arm.mpu_irq:
    platform_allow: mps2/an385
    integration_platforms:
      - mps2/an385
    tags:
      - arm
      - userspace
```

## tests/bluetooth/hci_disable_error/testcase.yaml
```yaml
# SPDX-License-Identifier: Apache-2.0
tests:
  bluetooth.hci_disable_error.close_failure:
    platform_allow: [native_sim/native/64]
    integration_platforms: [native_sim/native/64]
    tags: [bluetooth, hci]
  bluetooth.hci_disable_error.unsupported:
    extra_configs: [CONFIG_TEST_HCI_NO_CLOSE=y]
    platform_allow: [native_sim/native/64]
    integration_platforms: [native_sim/native/64]
    tags: [bluetooth, hci]
```

## tests/bluetooth/hci_h4_lifecycle/testcase.yaml
```yaml
# SPDX-License-Identifier: Apache-2.0
tests:
  bluetooth.hci_h4.lifecycle:
    platform_allow: [native_sim/native/64]
    integration_platforms: [native_sim/native/64]
    tags: [bluetooth, uart]
    timeout: 5
```

## tests/bluetooth/hci_timeout/testcase.yaml
```yaml
# SPDX-License-Identifier: Apache-2.0
tests:
  bluetooth.hci_timeout.system_queue:
    extra_configs: [CONFIG_BT_TX_PROCESSOR_THREAD=n]
    platform_allow: [native_sim/native/64]
    integration_platforms: [native_sim/native/64]
    tags: [bluetooth, hci]
  bluetooth.hci_timeout.tx_thread:
    extra_configs: [CONFIG_BT_TX_PROCESSOR_THREAD=y]
    platform_allow: [native_sim/native/64]
    integration_platforms: [native_sim/native/64]
    tags: [bluetooth, hci]
```

## tests/bluetooth/host/keys/bt_keys_br_eviction/testcase.yaml
```yaml
common:
  tags:
    - bluetooth
    - host
tests:
  bluetooth.host.bt_keys_br_eviction.ram_only:
    type: unit
```

## tests/drivers/adc/stm32_timeout/testcase.yaml
```yaml
# SPDX-License-Identifier: Apache-2.0
common:
  tags: [adc, drivers]
  depends_on: adc
  filter: CONFIG_ADC_STM32
  platform_allow: [nucleo_f401re]
tests:
  drivers.adc.stm32_timeout:
    integration_platforms: [nucleo_f401re]
```

## tests/drivers/uart/cmsdk_apb/testcase.yaml
```yaml
# SPDX-License-Identifier: Apache-2.0
tests:
  drivers.uart.cmsdk_apb.completion:
    tags:
      - drivers
      - uart
    platform_allow:
      - mps2/an385
    harness: ztest
```

## tests/drivers/uart/userspace_api/testcase.yaml
```yaml
# SPDX-License-Identifier: Apache-2.0

common:
  tags:
    - drivers
    - uart
    - userspace
  platform_allow:
    - mps2/an385
  harness: ztest
  filter: CONFIG_ARCH_HAS_USERSPACE

tests:
  drivers.uart.userspace_api.default_enabled:
  drivers.uart.userspace_api.disabled:
    extra_configs:
      - CONFIG_UART_USERSPACE=n
    extra_args: EXTRA_CPPFLAGS=-DTEST_UART_USERSPACE_DISABLED=1
    ignore_faults: true
```

## tests/drivers/usb/stm32_bc12/testcase.yaml
```yaml
tests:
  drivers.usb.stm32_bc12:
    tags: [drivers, usb, bc12]
    platform_allow: native_sim
```

## tests/drivers/userspace_access/testcase.yaml
```yaml
# SPDX-License-Identifier: Apache-2.0

common:
  tags:
    - drivers
    - uart
    - gpio
    - userspace
  platform_allow:
    - mps2/an385
  harness: ztest
  filter: CONFIG_ARCH_HAS_USERSPACE

tests:
  drivers.userspace_access.default_enabled:
  drivers.userspace_access.disabled:
    extra_configs:
      - CONFIG_UART_USERSPACE=n
      - CONFIG_GPIO_USERSPACE=n
    extra_args: EXTRA_CPPFLAGS=-DTEST_DRIVER_USERSPACE_DISABLED=1
    ignore_faults: true
```

## tests/kernel/threads/main_stack/testcase.yaml
```yaml
# SPDX-License-Identifier: Apache-2.0

common:
  tags:
    - kernel
    - threads
    - userspace
  platform_allow:
    - mps2/an385
  filter: CONFIG_ARCH_HAS_USERSPACE
  harness: console
  harness_config:
    type: one_line
    regex:
      - "main_stack: PASS"

tests:
  kernel.threads.main_stack.user_capable:
  kernel.threads.main_stack.kernel_only:
    extra_configs:
      - CONFIG_MAIN_THREAD_USERSPACE=n
    extra_args: EXTRA_CPPFLAGS=-DTEST_MAIN_THREAD_USERSPACE_DISABLED=1
```

## tests/subsys/mgmt/mcumgr/request_lifetime/testcase.yaml
```yaml
# SPDX-License-Identifier: Apache-2.0
tests:
  mgmt.mcumgr.request_lifetime:
    platform_allow:
      - native_sim/native/64
    integration_platforms:
      - native_sim/native/64
    tags:
      - mcumgr
```

## tests/subsys/mgmt/mcumgr/transport_shell/testcase.yaml
```yaml
# SPDX-License-Identifier: Apache-2.0
tests:
  mgmt.mcumgr.transport_shell.custom:
    platform_allow: native_sim/native/64
    integration_platforms:
      - native_sim/native/64
    extra_configs:
      - CONFIG_SHELL_BACKEND_SERIAL=n
    tags:
      - mcumgr
  mgmt.mcumgr.transport_shell.uart:
    platform_allow: native_sim/native/64
    integration_platforms:
      - native_sim/native/64
    extra_configs:
      - CONFIG_SHELL_BACKEND_SERIAL=y
    tags:
      - mcumgr
```

## tests/subsys/shell/shell_session/testcase.yaml
```yaml
tests:
  shell.session_reset:
    tags: shell
    platform_allow:
      - native_sim
      - native_sim/native/64
    integration_platforms:
      - native_sim/native/64
```

## tests/subsys/task_wdt/setup/testcase.yaml
```yaml
# SPDX-License-Identifier: Apache-2.0
tests:
  subsys.task_wdt.setup:
    platform_allow: [native_sim/native/64]
    integration_platforms: [native_sim/native/64]
    tags: [watchdog]
```
